## demo/stackchan/Kconfig
```kconfig
#
# For a description of the syntax of this configuration file,
# see the file kconfig-language.txt in the NuttX tools repository.
#

config EXAMPLES_STACKCHAN
	tristate "StackChan (M5Stack CoreS3) face and servo demo"
	default n
	depends on I2C_DRIVER && SPI_DRIVER && SPI_CMDDATA && SERIAL_TERMIOS
	---help---
		Draws a face on the CoreS3 LCD (/dev/spi3), drives the 12 LEDs
		and the servo power switch through the PY32 in the StackChan base
		(/dev/i2c0), and moves the pan/tilt Feetech SCS servos
		(UART1 at 1 Mbps).  "stackchan start" keeps blinking and
		looking around in a background task.

if EXAMPLES_STACKCHAN

config EXAMPLES_STACKCHAN_PROGNAME
	string "Program name"
	default "stackchan"

config EXAMPLES_STACKCHAN_PRIORITY
	int "stackchan task priority"
	default 100

config EXAMPLES_STACKCHAN_STACKSIZE
	int "stackchan stack size"
	default 4096

config EXAMPLES_STACKCHAN_SERVO_DEVPATH
	string "Servo UART device"
	default "/dev/ttyS0"
	---help---
		The UART wired to the servos (G6/G7 on the StackChan base).
		Serial devices are numbered in the order they are enabled, so
		with the console on USB-Serial/JTAG and UART0 disabled, UART1
		is /dev/ttyS0.

endif
```

## docker/spresense-denyinet/Kconfig
```kconfig
#
# For a description of the syntax of this configuration file,
# see the file kconfig-language.txt in the NuttX tools repository.
#

config SYSTEM_DENYINET
	tristate "denyinet: route new AF_INET sockets past the usrsock daemon"
	default n
	depends on NET_USRSOCK
	---help---
		NSH command "denyinet on|off" that issues SIOCDENYINETSOCK to the
		usrsock daemon. With "on", subsequently created AF_INET sockets
		fall back to the kernel network stack instead of being offloaded,
		which lets servers such as telnetd listen on a kernel netdev like
		wg0 while the tunnel itself keeps using the offloaded UDP socket.

if SYSTEM_DENYINET

config SYSTEM_DENYINET_PROGNAME
	string "Program name"
	default "denyinet"

config SYSTEM_DENYINET_PRIORITY
	int "Task priority"
	default 100

config SYSTEM_DENYINET_STACKSIZE
	int "Stack size"
	default DEFAULT_TASK_STACKSIZE

endif
```

## nuttx_port/apps/netutils/wireguard/Kconfig
```kconfig
#
# For a description of the syntax of this configuration file,
# see the file kconfig-language.txt in the NuttX tools repository.
#

config NET_WIREGUARD
	bool "WireGuard VPN support"
	default n
	depends on NET && NET_UDP && NET_TUN && NET_SOCKOPTS && ALLOW_BSD_COMPONENTS
	---help---
		Enable WireGuard VPN support for NuttX. Implements WireGuard as a
		"wg0" network device backed by a UDP socket (see NET_LL_TUN).
		Requires UDP and CONFIG_NET_TUN (for the NET_LL_TUN link type;
		the /dev/tun character device itself is not used).

		The vendored wireguard-lwip sources (wireguard.c, crypto/) are
		BSD-3-Clause licensed, same as NET_TUN's tun.c, hence the
		ALLOW_BSD_COMPONENTS dependency.

		NOTE: if you intend to configure the tunnel at runtime, raise
		CONFIG_NSH_LINELEN. A full "wg set peer" line carries a 44
		character base64 key plus an endpoint and allowed-ips and runs to
		about 134 characters; at the default of 64/80 NSH truncates it
		mid-argument and runs the remainder as separate commands. 160 is
		enough. Loading a file with "wg setconf" is not affected.

if NET_WIREGUARD

config NET_WIREGUARD_PROGNAME
	string "Program name"
	default "wg"
	---help---
		The name of the NSH builtin command that brings up wg0.

config NET_WIREGUARD_PRIORITY
	int "wg command task priority"
	default 100

config NET_WIREGUARD_STACKSIZE
	int "wg command stack size"
	default DEFAULT_TASK_STACKSIZE

config NET_WIREGUARD_RX_STACKSIZE
	int "WireGuard RX thread stack size"
	default 6144
	---help---
		Stack size of the background thread that receives WireGuard UDP
		packets and drives the handshake/keepalive timers.

		This thread decrypts each incoming packet and then calls
		ipv4_input() on it directly, so the whole receive-side depth of
		the network stack (and, for packets the stack answers straight
		away such as ICMP echo and TCP ACKs, a ChaCha20-Poly1305
		encryption of the reply on the way back out) runs on this stack
		rather than on the caller's.

		The default comes from measurement, but note how much the
		measurement moved with how long the board ran. On an ESP32-S3
		with CONFIG_STACK_COLORATION (IPv4 only, wg0 MTU 1420), a short
		burst of ~7 MB of TCP plus a ping flood left a high water mark of
		2960 bytes; a board left running for hours reached 3392. A brief
		load test is not a worst case here, because the deepest paths
		depend on which combination of stack states a packet happens to
		arrive in. 6144 keeps roughly 45% headroom over the larger
		observed figure.

		Raise it if you enable IPv6, IP fragmentation, or a larger MTU,
		or if you see stack overflows on an architecture with bigger
		frames. CONFIG_STACK_COLORATION plus "ps" reports the real usage
		- and let the board run before trusting the number.

config NET_WIREGUARD_MAX_PEERS
	int "Maximum number of peers"
	default 1
	range 1 16
	---help---
		How many peers wg0 can hold. Peers are stored statically inside the
		device structure (the vendored protocol code avoids malloc), so this
		is a direct RAM trade. Measured on ESP32-S3, .bss of the interface
		object grows by about 904 bytes per additional peer:

			1 peer   4324 bytes
			2 peers  5228 bytes
			4 peers  7036 bytes
			8 peers 10652 bytes

		Most of that is the three key pairs each peer keeps so that rekeying
		can overlap with traffic still using the old keys.

		1 is right for a device that dials home to a single server. Raise it
		to terminate several tunnels, for example a gateway reached by more
		than one operator.

config NET_WIREGUARD_MAX_SRC_IPS
	int "Maximum allowed-ips entries per peer"
	default 2
	range 1 8
	---help---
		How many allowed-ips ranges each peer may carry. Traffic is routed
		to a peer by matching the destination against these, so a peer that
		fronts several subnets needs one entry per subnet.

config NET_WIREGUARD_LISTEN_PORT
	int "UDP listen port"
	default 51820

config NET_WIREGUARD_CONFIG_PATH
	string "Default configuration file"
	default "/data/wg0.conf"
	---help---
		Path used by "wg setconf" when no file is given, and the file the
		board start-up script loads before "wg up" so that a configuration
		survives a reboot. Save the current settings there with:

			wg showconf > /data/wg0.conf

		The format is the same INI-style layout wg(8) uses, so the file is
		interchangeable with a desktop WireGuard configuration.

		This needs a writable file system mounted at that location. On
		esp32s3-devkit the board already mounts SPIFFS at /data.

config NET_WIREGUARD_PRIVATE_KEY
	string "Private key (base64)"
	default ""
	---help---
		Base64-encoded Curve25519 private key for this device. Required -
		wg0 will fail to come up if this is left empty.

config NET_WIREGUARD_LOCAL_IPADDR
	string "wg0 tunnel IPv4 address"
	default "10.10.0.2"
	---help---
		Deliberately a different subnet from the sim/qemu sample boards'
		own default eth0 address (10.0.0.2), so wg0 doesn't collide with
		it when both are brought up in the same development image.

config NET_WIREGUARD_LOCAL_NETMASK
	string "wg0 tunnel IPv4 netmask"
	default "255.255.255.0"

config NET_WIREGUARD_PEER_PUBLIC_KEY
	string "Peer public key (base64)"
	default ""
	---help---
		Base64-encoded Curve25519 public key of the single WireGuard peer
		to configure at boot. Leave empty to bring wg0 up with no peers
		(useful for build/bring-up testing before a peer is available).

config NET_WIREGUARD_PEER_ENDPOINT_IP
	string "Peer endpoint IPv4 address"
	default ""
	---help---
		If set, wg0 actively initiates a handshake to this address:port
		once the interface is up. If left empty, this device only responds
		to handshakes initiated by the peer.

config NET_WIREGUARD_PEER_ENDPOINT_PORT
	int "Peer endpoint UDP port"
	default 51820

config NET_WIREGUARD_PEER_ALLOWED_IP
	string "Peer allowed IPv4 address"
	default "10.10.0.1"

config NET_WIREGUARD_PEER_ALLOWED_MASK
	string "Peer allowed IPv4 netmask"
	default "255.255.255.255"

config NET_WIREGUARD_PEER_KEEPALIVE
	int "Peer persistent keepalive (seconds, 0 to disable)"
	default 25

endif # NET_WIREGUARD
```
